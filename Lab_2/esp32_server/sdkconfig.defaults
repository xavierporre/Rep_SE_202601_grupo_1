## Lab_2/esp32_server/sdkconfig.defaults
```kconfig
# Framework Arduino sobre ESP-IDF
CONFIG_ARDUINO_ENABLE=y

# WiFi
CONFIG_ESP_WIFI_SOFTAP_SUPPORT=y
CONFIG_ESP32_WIFI_ENABLED=y

# Tamaño de stack suficiente para WebServer
CONFIG_ARDUINO_LOOP_STACK_SIZE=8192

# Puerto serie
CONFIG_ESP_CONSOLE_UART_DEFAULT=y
CONFIG_ESP_CONSOLE_UART_BAUDRATE=115200

# Chip
CONFIG_IDF_TARGET="esp32s3"
```

## Proyecto/robot_cam/sdkconfig.defaults
```kconfig
CONFIG_FLASHMODE_QIO=y
CONFIG_ESPTOOLPY_FLASHMODE="QIO"
CONFIG_ESPTOOLPY_FLASHFREQ_80M=y
CONFIG_ESPTOOLPY_FLASHFREQ="80m"
CONFIG_ESPTOOLPY_FLASHSIZE_4MB=y
CONFIG_ESPTOOLPY_FLASHSIZE="4MB"
CONFIG_ESPTOOLPY_FLASHSIZE_DETECT=y

CONFIG_MONITOR_BAUD_115200B=y
CONFIG_MONITOR_BAUD=115200
CONFIG_COMPILER_OPTIMIZATION_PERF=y

CONFIG_OV2640_SUPPORT=y

CONFIG_ESP32_DEFAULT_CPU_FREQ_240=y
CONFIG_ESP32_DEFAULT_CPU_FREQ_MHZ=240
CONFIG_ESP32_SPIRAM_SUPPORT=y
CONFIG_SPIRAM_BOOT_INIT=y
CONFIG_SPIRAM_USE_CAPS_ALLOC=y
CONFIG_SPIRAM_TYPE_AUTO=y
CONFIG_SPIRAM_MODE_QUAD=y
CONFIG_SPIRAM_SIZE=-1
CONFIG_SPIRAM_SPEED_80M=y
CONFIG_SPIRAM_MEMTEST=y
CONFIG_SPIRAM_CACHE_WORKAROUND=y
CONFIG_SPIRAM_BANKSWITCH_ENABLE=y
CONFIG_SPIRAM_BANKSWITCH_RESERVE=8
CONFIG_CAMERA_MODULE_AI_THINKER=y
CONFIG_FREERTOS_USE_TRACE_FACILITY=y
CONFIG_FREERTOS_USE_STATS_FORMATTING_FUNCTIONS=y
CONFIG_FREERTOS_GENERATE_RUN_TIME_STATS=y
CONFIG_PARTITION_TABLE_CUSTOM=y
CONFIG_PARTITION_TABLE_CUSTOM_FILENAME="partitions.csv"
CONFIG_PARTITION_TABLE_FILENAME="partitions.csv"
```

## Proyecto/robot_s3/sdkconfig.defaults
```kconfig
# Chip
CONFIG_IDF_TARGET="esp32s3"

# WiFi (modo AP)
CONFIG_ESP_WIFI_SOFTAP_SUPPORT=y

# Puerto serie
CONFIG_ESP_CONSOLE_UART_DEFAULT=y
CONFIG_ESP_CONSOLE_UART_BAUDRATE=115200
```
